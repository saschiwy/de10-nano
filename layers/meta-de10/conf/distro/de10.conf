## layers/meta-de10/conf/distro/de10.conf
```bitbake
DISTRO = "de10"
DISTRO_NAME = "DE10-Nano Distro"
DISTRO_VERSION = "1.0"
DISTRO_CODENAME = "scarthgap"

MAINTAINER = "de10"

TARGET_VENDOR = "-de10"

LOCALCONF_VERSION = "2"

# Switch to systemd
DISTRO_FEATURES:append = " systemd usrmerge"
DISTRO_FEATURES_BACKFILL_CONSIDERED += "sysvinit"
VIRTUAL-RUNTIME_init_manager = "systemd"
VIRTUAL-RUNTIME_initscripts = "systemd-compat-units"

DISTRO_EXTRA_RDEPENDS += "packagegroup-core-boot"
DISTRO_EXTRA_RRECOMMENDS += "kernel-module-af-packet"

TCLIBCAPPEND = ""

PACKAGE_CLASSES ?= "package_ipk"

SDK_VENDOR = "-de10sdk"
SDK_VERSION = "${DISTRO_VERSION}"
SDK_NAME = "${DISTRO}-${TCLIBC}-${SDKMACHINE}-${IMAGE_BASENAME}-${TUNE_PKGARCH}-${MACHINE}"
SDKPATHINSTALL = "/opt/${DISTRO}/${SDK_VERSION}"
```
